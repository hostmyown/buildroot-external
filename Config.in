## Config.in
```kconfig
source "$BR2_EXTERNAL_HOSTMYOWN_PATH/package/hello-autotools/Config.in"
source "$BR2_EXTERNAL_HOSTMYOWN_PATH/package/hello-cmake/Config.in"
source "$BR2_EXTERNAL_HOSTMYOWN_PATH/package/hello-generic/Config.in"
```

## package/hello-autotools/Config.in
```kconfig
config BR2_PACKAGE_HELLO_AUTOTOOLS
	bool "hello_autotools"
	help
	  Hello autotools project.

	  https://hostmyown.com
```

## package/hello-cmake/Config.in
```kconfig
config BR2_PACKAGE_HELLO_CMAKE
	bool "hello_cmake"
	help
	  Hello CMake project.

	  https://hostmyown.com
```

## package/hello-generic/Config.in
```kconfig
config BR2_PACKAGE_HELLO_GENERIC
	bool "hello_generic"
	help
	  Hello generic project.

	  https://hostmyown.com
```

## package/ufw/Config.in
```kconfig
config BR2_PACKAGE_UFW
	bool "ufw"
	help
	  Uncomplicated Firewall.

	  https://hostmyown.com
```
